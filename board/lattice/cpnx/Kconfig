## board/lattice/cpnx/Kconfig
```kconfig
if TARGET_LATTICE_RISCV

config SYS_CPU
	default "generic"

config SYS_BOARD
	default "cpnx"

config SYS_VENDOR
	default "lattice"

config SYS_CONFIG_NAME
	default "lattice-riscv"

config TEXT_BASE
	default 0x80100000 if SPL
	default 0x80100000 if !RISCV_SMODE
	default 0x80100000 if RISCV_SMODE

config SPL_TEXT_BASE
	default 0x00000000

config BOARD_SPECIFIC_OPTIONS # dummy
	def_bool y
	select GENERIC_RISCV
	select SUPPORT_SPL
	imply CMD_CPU
	imply CMD_DHCP
	imply CMD_GPIO
	imply CMD_NET
	imply CMD_PING
	imply CMD_SF
	imply DM_GPIO
	imply MII
	imply PHY_LIB
	imply PHY_MSCC

endif
```

## configs/lattice_riscv_defconfig
```kconfig
CONFIG_RISCV=y
CONFIG_XIP=y
CONFIG_SPL_XIP=y
CONFIG_RISCV_ISA_F=n
CONFIG_RISCV_ISA_D=n
CONFIG_SPL_SMP=n
CONFIG_NR_CPUS=1
CONFIG_SPL_SHARES_INIT_SP_ADDR=n
#CONFIG_SPL_STACK=0x36000
CONFIG_SPL_STACK=0x1A000
CONFIG_SYS_MALLOC_LEN=0x800000
CONFIG_NR_DRAM_BANKS=1
CONFIG_HAS_CUSTOM_SYS_INIT_SP_ADDR=y
CONFIG_CUSTOM_SYS_INIT_SP_ADDR=0x80200000
CONFIG_ENV_SIZE=0x20000
CONFIG_DEFAULT_DEVICE_TREE="lattice_cpnx"
CONFIG_SYS_MONITOR_LEN=786432
CONFIG_SPL=y
CONFIG_SYS_LOAD_ADDR=0x90000000
CONFIG_TARGET_LATTICE_RISCV_LFCPNX=y
CONFIG_RISCV_MMODE=y
CONFIG_FIT=y
CONFIG_DISTRO_DEFAULTS=y
CONFIG_DISPLAY_CPUINFO=y
CONFIG_DISPLAY_BOARDINFO=y
CONFIG_SPL_MAX_SIZE=0x10000
CONFIG_SPL_BSS_START_ADDR=0x00010000
CONFIG_SPL_BSS_MAX_SIZE=0x5000
CONFIG_SPL_SYS_MALLOC=y
#CONFIG_SPL_HAS_CUSTOM_MALLOC_START=y
CONFIG_SPL_CUSTOM_SYS_MALLOC_ADDR=0x00035000
CONFIG_SPL_SYS_MALLOC_SIZE=0xA000
CONFIG_SYS_BOOTM_LEN=0x4000000
CONFIG_SYS_RELOC_GD_ENV_ADDR=y
CONFIG_DM_MTD=y
CONFIG_FLASH_SHOW_PROGRESS=0
CONFIG_SYS_MAX_FLASH_BANKS=2
CONFIG_DM_SERIAL=y
CONFIG_LATTICE_UART=y
CONFIG_SPL_DM=y
CONFIG_SPL_DM_SERIAL=y
CONFIG_SPL_OF_CONTROL=y
CONFIG_OF_CONTROL=y
CONFIG_TIMER=y
CONFIG_SPL_TIMER=y
CONFIG_SPL_OF_TRANSLATE=y
CONFIG_REGMAP=y
CONFIG_SPL_REGMAP=y
CONFIG_RAM=y
CONFIG_SPI=y
CONFIG_DM_SPI=y
CONFIG_LATTICE_QSPI=y
CONFIG_DM_SPI_FLASH=y
CONFIG_SPI_FLASH=y
CONFIG_SPI_FLASH_MACRONIX=n
CONFIG_SPI_FLASH_WINBOND=y
CONFIG_SF_DEFAULT_SPEED=100000000
CONFIG_MTD=y
CONFIG_SPL_MTD=y
CONFIG_CMD_MTD=y
CONFIG_USE_SYS_MAX_FLASH_BANKS=y
CONFIG_SPI_FLASH_MTD=y
CONFIG_MTD_NOR_FLASH=y
CONFIG_SYS_MAX_FLASH_SECT=1024
CONFIG_SPL_MTD_LOAD=y
CONFIG_SPL_ENV_SUPPORT=y
CONFIG_SPL_OPENSBI=n
CONFIG_BINMAN=n
CONFIG_SPL_RAM=y
#CONFIG_SPL_RAM_SUPPORT=y
CONFIG_LATTICE_REG_ACCESS=y
CONFIG_DM_GPIO=y
CONFIG_LATTICE_GPIO=y
CONFIG_DMA=y
CONFIG_LATTICE_SGDMA=y
CONFIG_LATTICE_TSE=y
CONFIG_TFTP_BLOCKSIZE=512
CONFIG_CRC_CHECKING=y
CONFIG_SPL_SYS_MALLOC_SIMPLE=y
CONFIG_SPL_SYS_MALLOC_F=y
CONFIG_SPL_SYS_MALLOC_F_LEN=0x3000
CONFIG_CMD_I2C=y
CONFIG_DM_I2C=y
CONFIG_SYS_I2C_LATTICE=y
CONFIG_USE_BOOTCOMMAND=y
CONFIG_BOOTCOMMAND="setenv ipaddr 192.168.1.3; setenv netmask 255.255.255.0; setenv gatewayip 192.168.1.1;"
CONFIG_SPL_LATTICE_DDR=y
```

## drivers/ddr/lattice/Kconfig
```kconfig
config SPL_LATTICE_DDR
	bool "Lattice RISC-V LPDDR4 driver in SPL"
	depends on SPL
	depends on TARGET_LATTICE_RISCV_LFCPNX
	select RAM if TARGET_LATTICE_RISCV_LFCPNX
	select SPL_RAM if TARGET_LATTICE_RISCV_LFCPNX
	help
	  Enable LPDDR4 SDRAM controller for the Lattice RISC-V devices.
```
